## boards/arm/typepak/Kconfig.defconfig
```kconfig
if BOARD_TYPEPAK

config BOARD
    default "typepak"

if USB_DEVICE_STACK

config USB_NRFX
    default y

endif # USB_DEVICE_STACK

config BT_CTLR
    default BT

config BOARD_TYPEPAK_CHARGER
    default y

endif # BOARD_TYPEPAK
```

## boards/shields/tester-xiao-tweak/Kconfig.defconfig
```kconfig
if SHIELD_TESTER_XIAO

config ZMK_KEYBOARD_NAME
    default "ZMK Tester"

config SPI
    default y

config ZMK_POINTING
    default y

config ZMK_BLE
    def_bool n
    
endif
```

## boards/shields/type-boy-pwing/Kconfig.defconfig
```kconfig
if SHIELD_TYPEBOY_PWING

config ZMK_KEYBOARD_NAME
    default "Type Boy P-Wing"

config SPI
    default y

config ZMK_POINTING
    default y

config ZMK_DISPLAY
	select LV_FONT_MONTSERRAT_28

config LS0XX
	default y
    
config ZMK_DISPLAY_INVERT
	default y

endif
```

## config/west.yml
```yaml
manifest:
  remotes:
    - name: zmkfirmware
      url-base: https://github.com/zmkfirmware
    # Additional modules containing boards/shields/custom code can be listed here as well
    # See https://docs.zephyrproject.org/3.2.0/develop/west/manifest.html#projects
    - name: petejohanson
      url-base: https://github.com/petejohanson
    - name: kbrd-space
      url-base: https://github.com/kbrd-space
  projects:
    - name: zmk
      remote: zmkfirmware
      import: app/west.yml
      revision: v0.3
    - name: cirque-input-module
      remote: petejohanson
      revision: main
    - name: zmk-anti-idle
      remote: kbrd-space
      revision: main
  self:
    path: config
```
